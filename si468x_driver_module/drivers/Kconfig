## si468x_driver_module/drivers/radio/si468x/Kconfig
```kconfig
config SI468X
	bool "Custom SI468X Driver"
	default n
	depends on DT_HAS_ZEPHYR_SI468X_ENABLED
	select SPI
	help
	  Enable SI468X driver
```

## si468x_driver_module/dts/bindings/radio/zephyr,si46xx.yaml
```yaml
description: Skyworks si468x DAB/FM RDS receiver and decoder

compatible: "zephyr,si468x"

include: [spi-device.yaml]
```
